## conf/layer.conf
```bitbake
# Neural Analytics Layer Configuration
# This file enables the repository to function as a Yocto layer

BBPATH .= ":${LAYERDIR}"

# Include the recipe from the layer root
BBFILES += "${LAYERDIR}/*.bb ${LAYERDIR}/*.bbappend"

BBFILE_COLLECTIONS += "neural-analytics"
BBFILE_PATTERN_neural-analytics = "^${LAYERDIR}/"
BBFILE_PRIORITY_neural-analytics = "6"

# Layer dependencies
LAYERDEPENDS_neural-analytics = "core"

# Compatible with recent Yocto releases
LAYERSERIES_COMPAT_neural-analytics = "mickledore nanbield scarthgap styhead"

# Layer metadata
LAYER_CONF_VERSION = "7"
```
